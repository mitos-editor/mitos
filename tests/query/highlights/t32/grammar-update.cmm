PRIVATE &input
 RETURN 1
;^ @keyword.control.return
 ENDDO
;^ @keyword.control.return
